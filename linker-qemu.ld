ENTRY(_start)

SECTIONS
{
    /*
     * QEMU AArch64 virt machine
     *
     * Kernel load address:
     *     0x40080000
     */
    . = 0x40080000;

    __start = .;

    /* ------------------------------------------------------------ */
    /* Text                                                          */
    /* ------------------------------------------------------------ */

    __text_start = .;

    .text : ALIGN(4096)
    {
        KEEP(*(.text.boot))
        *(.text*)
    }

    . = ALIGN(4096);

    __text_end = .;


    /* ------------------------------------------------------------ */
    /* Read-only data                                                */
    /* ------------------------------------------------------------ */

    __rodata_start = .;

    .rodata : ALIGN(4096)
    {
        *(.rodata*)
    }

    . = ALIGN(4096);

    __rodata_end = .;


    /* ------------------------------------------------------------ */
    /* Initialised data                                              */
    /* ------------------------------------------------------------ */

    __data_start = .;

    .data : ALIGN(4096)
    {
        *(.data*)
    }

    . = ALIGN(4096);

    __data_end = .;


    /* ------------------------------------------------------------ */
    /* BSS                                                           */
    /* ------------------------------------------------------------ */

    __bss_start = .;

    .bss : ALIGN(4096)
    {
        bss = .;

        *(.bss*)
        *(COMMON)
    }

    . = ALIGN(4096);

    __bss_end = .;

    /* ------------------------------------------------------------ */
    /* End                                                           */
    /* ------------------------------------------------------------ */

    __end = .;
}